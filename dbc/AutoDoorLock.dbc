VERSION ""

NS_ :

BS_:

BU_: InstrumentCluster BodyECU

BO_ 2 DoorLockStatus: 1 BodyECU
 SG_ DoorLock : 0|1@1+ (1,0) [0|1] "" Vector__XXX

BO_ 1 CarSpeedValue: 4 InstrumentCluster
 SG_ Speed : 0|8@1+ (1,0) [0|180] "km / hour" Vector__XXX

EV_ KL15: 0 [0|1] "" 0 1 DUMMY_NODE_VECTOR0 Vector__XXX;

CM_ EV_ KL15 "KL15 gives the engine ignition swtich position - mapped to engine start-stop button";
BA_DEF_  "BusType" STRING ;
BA_DEF_DEF_  "BusType" "CAN";
